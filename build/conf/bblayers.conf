## build/conf/bblayers.conf
```bitbake
LCONF_VERSION = "7"

BBPATH = "${TOPDIR}"
BBFILES ?= ""

YOCTOROOT = "${@os.path.abspath(os.path.join("${TOPDIR}", os.pardir))}"

BBLAYERS ?= " \
    ${YOCTOROOT}/poky/meta \
    ${YOCTOROOT}/poky/meta-poky \
    ${YOCTOROOT}/meta-openembedded/meta-perl \
    ${YOCTOROOT}/meta-openembedded/meta-python \
    ${YOCTOROOT}/meta-openembedded/meta-filesystems \
    ${YOCTOROOT}/meta-openembedded/meta-gnome \
    ${YOCTOROOT}/meta-openembedded/meta-multimedia \
    ${YOCTOROOT}/meta-openembedded/meta-networking \
    ${YOCTOROOT}/meta-openembedded/meta-webserver \
    ${YOCTOROOT}/meta-openembedded/meta-xfce \
    ${YOCTOROOT}/meta-openembedded/meta-initramfs \
    ${YOCTOROOT}/meta-openembedded/meta-oe \
    ${YOCTOROOT}/meta-xilinx/meta-xilinx-bsp \
    ${YOCTOROOT}/meta-xilinx/meta-xilinx-pynq \
    ${YOCTOROOT}/meta-xilinx-tools \
    ${YOCTOROOT}/meta-petalinux \
    ${YOCTOROOT}/meta-clang \
    ${YOCTOROOT}/meta-openamp \
    ${YOCTOROOT}/meta-user \
"

BBMASK += " \
    ${YOCTOROOT}/meta-petalinux/recipes-browser \
    ${YOCTOROOT}/meta-petalinux/recipes-extended/images \
    ${YOCTOROOT}/meta-petalinux/recipes-extended/xen \
    ${YOCTOROOT}/meta-petalinux/recipes-qt \
"
```

## build/conf/local.conf
```bitbake
MACHINE="ultra96v2" 
DISTRO = "poky"

PACKAGE_CLASSES ?= "package_deb"
EXTRA_IMAGE_FEATURES ?= "debug-tweaks"
USER_CLASSES ?= "buildstats image-mklibs image-prelink"

CORE_IMAGE_EXTRA_INSTALL += "\
    kernel-modules \
"

PREFERRED_VERSION_virtual/bootloader = "2020.01%"

PATCHRESOLVE = "noop"

BB_DISKMON_DIRS ??= "\
    STOPTASKS,${TMPDIR},1G,100K \
    STOPTASKS,${DL_DIR},1G,100K \
    STOPTASKS,${SSTATE_DIR},1G,100K \
    STOPTASKS,/tmp,100M,100K \
    ABORT,${TMPDIR},100M,1K \
    ABORT,${DL_DIR},100M,1K \
    ABORT,${SSTATE_DIR},100M,1K \
    ABORT,/tmp,10M,1K"


PACKAGECONFIG_append_pn-qemu-system-native = " sdl"

CONF_VERSION = "1"

COMPATIBLE_MACHINE_ultra96v2 = "ultra96v2"

LICENSE_FLAGS_WHITELIST += " commercial"
LICENSE_FLAGS_WHITELIST += " xilinx"

IMAGE_FSTYPES = " tar.gz cramfs"

BB_NUMBER_THREADS = "12"
PARALLEL_MAKE = "-j 12"
```

## meta-user/conf/machine/ultra96v2.conf
```bitbake
#@TYPE: Machine
#@NAME: ultra96v2
#@DESCRIPTION: Machine support for ultra96v2.
#

DEFAULTTUNE = "cortexa53"
SOC_VARIANT = "eg"

require conf/machine/include/soc-zynqmp.inc
require conf/machine/include/machine-xilinx-default.inc

MACHINE_FEATURES = "rtc ext2 ext3 vfat usbhost usbgadget wifi bluetooth"

UBOOT_MACHINE = "xilinx_zynqmp_virt_defconfig"
# prevent U-Boot from deploying the boot.bin
SPL_BINARY = ""

SERIAL_CONSOLES = "115200;ttyPS0"

KERNEL_DEVICETREE = "xilinx/zynqmp-zcu100-revC.dtb"

PMU_FIRMWARE_IMAGE_NAME ?= "pmu-firmware-zynqmp-pmu"
PMU_FIRMWARE_DEPLOY_DIR ?= "${TOPDIR}/pmutmp/deploy/images/zynqmp-pmu"

MACHINE_EXTRA_RRECOMMENDS += "kernel-modules"
MACHINE_ESSENTIAL_EXTRA_RDEPENDS += "wilc3000-fw"

EXTRA_IMAGEDEPENDS += " \
		u-boot-zynq-uenv \
		arm-trusted-firmware \
		virtual/boot-bin \
		virtual/bootloader \
		u-boot-zynq-scr \
"
IMAGE_BOOT_FILES += " \
		uEnv.txt \
		atf-uboot.ub \
		boot.scr \
"
```
